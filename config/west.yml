## config/west.yml
```yaml
manifest:
  remotes:
    - name: moergo-sc
      url-base: https://github.com/moergo-sc
    - name: bryan
      url-base: https://github.com/bryanforbes
    - name: imeredith
      url-base: https://github.com/imeredith
    - name: caksoylar
      url-base: https://github.com/caksoylar
  projects:
    - name: zmk
      remote: moergo-sc
      revision: main
      import: app/west.yml
    - name: zmk-smart-toggle
      remote: caksoylar
      revision: main
    path: config
```
